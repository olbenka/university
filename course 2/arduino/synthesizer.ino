#include <Keypad.h>

const byte ROWS = 4; 
const byte COLS = 4; 

char hexaKeys[ROWS][COLS] = {
  {'1','2','3','A'},
  {'4','5','6','B'},
  {'7','8','9','C'},
  {'*','0','#','D'}
};

bool val = false;
int h = 1;

byte rowPins[ROWS] = {12, 11, 10, 9}; 
byte colPins[COLS] = {8, 7, 6, 5}; 

Keypad keypad = Keypad( makeKeymap(hexaKeys), rowPins, colPins, ROWS, COLS);

const int sinus[1024] 
{
  0x800,0x80d,0x819,0x826,0x832,0x83f,0x84b,0x858,0x865,0x871,
  0x87e,0x88a,0x897,0x8a3,0x8b0,0x8bc,0x8c9,0x8d5,0x8e2,0x8ee,
  0x8fb,0x907,0x914,0x920,0x92d,0x939,0x946,0x952,0x95e,0x96b,
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  0x7da,0x7e7,0x7f3,0x800
};

const int wave[1024] 
{
  0x0,0x10,0x20,0x30,0x40,0x4f,0x5f,0x6f,0x7e,0x8e,
  0x9d,0xac,0xbc,0xcb,0xda,0xe9,0xf8,0x107,0x116,0x125,
  0x134,0x143,0x152,0x160,0x16f,0x17d,0x18c,0x19a,0x1a9,0x1b7,
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  0xfb4,0xfb4,0xfb5,0xfb5
};

void generate(double coef, bool val, int h)
{
   for(int tmr = 0; tmr < 100*coef; ++tmr)
   {             
    for(int i = 0; i < 1024; i+=h*coef)
    {            
      if (val)
        analogWrite(DAC1, sinus[i]);                   
      else 
        analogWrite(DAC1, wave[i]);
    }
  }
}

void setup()
{
 analogWriteResolution(12);
 
 pinMode (8, OUTPUT);
 pinMode (7, OUTPUT);
 pinMode (6, OUTPUT);
 pinMode (5, OUTPUT);
  
 pinMode (12, INPUT); 
 digitalWrite(12, HIGH);
 pinMode (11, INPUT);
 digitalWrite(11, HIGH);
 pinMode (10, INPUT);
 digitalWrite(10, HIGH);
 pinMode (9, INPUT);
 digitalWrite(9, HIGH);
 
 pinMode(DAC1, OUTPUT);
}


void loop()
{
  char key = keypad.getKey();
  switch (key)
  {
    default:
      break;
    case '1':
      generate(1, val, h);
      break;
    case '2':
      generate(2, val, h);
      break;
    case '3':
      generate(3, val, h);
      break;
    case '4':
      generate(4, val, h);
      break;
    case '5':
      generate(5, val, h);
      break;
    case '6':
      generate(6, val, h);
      break;
    case '7':
      generate(7, val, h);
      break;
    case '8':
      generate(8, val, h);
      break;
    case '9':
      generate(9, val, h);
      break;
    case 'A':
      val = !val;
      break;
    case 'B':
      if (h < 10)
        ++h;
      else 
        h = 1;
      break;
  }
}
